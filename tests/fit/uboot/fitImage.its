## tests/fit/uboot/fitImage.its
```
/dts-v1/;
/ {
	description ="fitImage for Foo";
	images {
		kernel {
			description ="Linux kernel";
			data = /incbin/("../kernel/zImage");
			type ="kernel";
			arch ="arm";
			os ="linux";
			compression ="none";
			load = <0x10008000>;
			entry = <0x10008000>;
			hash-1 {
				algo = "sha256";
			};
		};
		fdt {
			description ="DTB for Foo";
			data = /incbin/("../kernel/kernel.dtb");
			type ="flat_dt";
			arch ="arm";
			compression ="none";
			hash-1 {
				algo = "sha256";
			};
		};
	};
	configurations {
		default="conf";
		conf{
			kernel ="kernel";
			fdt ="fdt";
			signature {
				algo ="sha256,rsa4096";
				key-name-hint ="uboot_sign_key";
				sign-images = "fdt", "kernel";
			};
		};
	};
};
```
